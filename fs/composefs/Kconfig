## fs/composefs/Kconfig
```kconfig
# SPDX-License-Identifier: GPL-2.0-only

config COMPOSEFS_FS
	tristate "Composefs filesystem support"
	select EXPORTFS
	help
	  Composefs is a filesystem that allows combining file content from
	  existing regular files with a metadata directory structure from
	  a separate binary file. This is useful to share file content between
	  many different directory trees, such as in a local container image store.

	  Composefs also allows using fs-verity to validate the content of the
	  content-files as well as the metadata file which allows dm-verity
	  like validation with the flexibility of regular files.

	  For more information see Documentation/filesystems/composefs.rst

	  If unsure, say N.
```
